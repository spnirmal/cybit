/dts-v1/;
/plugin/;

/ {
    compatible = "brcm,bcm2835";

    /* Rotary encoder GPIO configuration */
    fragment@0 {
        target = <&gpio>;
        __overlay__ {
            cybit_pins: cybit_pins {
                brcm,pins = <5 6 26>;
                brcm,function = <0>;
                brcm,pull = <2>;
            };
        };
    };

    /* Rotary encoder driver */
    fragment@1 {
        target-path = "/";
        __overlay__ {
            cybit_rotary: cybit_rotary {
                compatible = "custom,cybit-rotary";
                pinctrl-names = "default";
                pinctrl-0 = <&cybit_pins>;
                status = "okay";

                a-gpios      = <&gpio 5 1>;
                b-gpios      = <&gpio 6 1>;
                button-gpios = <&gpio 26 1>;
            };
        };
    };
};
